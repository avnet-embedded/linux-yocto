## Documentation/devicetree/bindings/sound/xlnx,i2s.yaml
```yaml
# SPDX-License-Identifier: (GPL-2.0-only OR BSD-2-Clause)
%YAML 1.2
---
$id: http://devicetree.org/schemas/sound/xlnx,i2s.yaml#
$schema: http://devicetree.org/meta-schemas/core.yaml#

title: Xilinx I2S Playback/Capture audio system

description:
  IP I2S Transmitter and receiver cores are soft IP cores in AMD Vivado
  design suite which make it easy to implement Inter-IC-Sound (I2S)
  interface used to connect audio devices for transmitting and
  receiving PCM audio.

maintainers:
  - Vincenzo Frascino <vincenzo.frascino@arm.com>
  - Katta Dhanunjanrao <katta.dhanunjanrao@amd.com>

properties:
  compatible:
    enum:
      - xlnx,i2s-receiver-1.0
      - xlnx,i2s-transmitter-1.0

  reg:
    maxItems: 1

  clocks:
    description: List of clock specifiers.
    items:
      - description: Input audio clock.
      - description: Input clock for AXI4-Lite Interface.
      - description: AXIS Audio streaming clock.

  clock-names:
    maxItems: 3

  interrupts:
    maxItems: 1

  xlnx,dwidth:
    $ref: /schemas/types.yaml#/definitions/uint32
    enum:
      - 16
      - 24
    description: |
      Indicates the I2S data width of the core.

  xlnx,num-channels:
    $ref: /schemas/types.yaml#/definitions/uint32
    minimum: 1
    maximum: 4
    description: |
      Indicates the number of audio channels supported.
      supported channels = 2 * xlnx,num-channels.

  xlnx,snd-pcm:
    $ref: /schemas/types.yaml#/definitions/phandle
    description: Reference to audio formatter block.

  xlnx,32bit-lr:
    type: boolean
    description: Core configuration either master or slave.

required:
  - compatible
  - reg
  - clocks
  - clock-names
  - xlnx,dwidth
  - xlnx,num-channels
  - xlnx,snd-pcm

additionalProperties: false

allOf:
  - $ref: dai-common.yaml#

  - if:
      properties:
        compatible:
          contains:
            const: xlnx,i2s-transmitter-1.0
    then:
      properties:
        clock-names:
          items:
            - const: aud_mclk
            - const: s_axi_ctrl_aclk
            - const: s_axis_aud_aclk
  - if:
      properties:
        compatible:
          contains:
            const: xlnx,i2s-receiver-1.0
    then:
      properties:
        clock-names:
          items:
            - const: aud_mclk
            - const: s_axi_ctrl_aclk
            - const: m_axis_aud_aclk

examples:
  - |
    i2s@a0080000 {
      compatible = "xlnx,i2s-receiver-1.0";
      reg = <0xa0080000 0x10000>;
      clocks = <&audio_ss_0_clk_wiz_0 0>, <&zynqmp_clk 71>, <&audio_ss_0_clk_wiz_0 0>;
      clock-names = "aud_mclk" , "s_axi_ctrl_aclk", "m_axis_aud_aclk";
      xlnx,dwidth = <0x18>;
      xlnx,num-channels = <1>;
      xlnx,snd-pcm = <&audio_ss_0_audio_formatter_2>;
    };
    i2s@a0090000 {
      compatible = "xlnx,i2s-transmitter-1.0";
      reg = <0xa0090000 0x10000>;
      clocks = <&audio_ss_0_clk_wiz_0 0>, <&zynqmp_clk 71>, <&audio_ss_0_clk_wiz_0 0>;
      clock-names = "aud_mclk" , "s_axi_ctrl_aclk" , "s_axis_aud_aclk";
      xlnx,dwidth = <0x18>;
      xlnx,num-channels = <1>;
      xlnx,snd-pcm = <&audio_ss_0_audio_formatter_2>;
    };
...
```

## Documentation/devicetree/bindings/sound/xlnx,spdif.yaml
```yaml
# SPDX-License-Identifier: (GPL-2.0-only OR BSD-2-Clause)
%YAML 1.2
---
$id: http://devicetree.org/schemas/sound/xlnx,spdif.yaml#
$schema: http://devicetree.org/meta-schemas/core.yaml#

title: Xilinx S/PDIF/AES3 Playback/Capture audio system

description:
  IP SPDIF/AES3 cores are soft IP cores in AMD Vivado.
  The Sony/Philips Digital Interconnect Format (SPDIF) and AES3
  are digital audio interfaces that implements the IEC 60958 interface
  for transmitting and receiving audio data.

maintainers:
  - Vincenzo Frascino <vincenzo.frascino@arm.com>
  - Katta Dhanunjanrao <katta.dhanunjanrao@amd.com>

properties:
  compatible:
    const: xlnx,spdif-2.0

  reg:
    maxItems: 1

  interrupts:
    maxItems: 1

  clock-names:
    maxItems: 3

  clocks:
    description: List of clock specifiers.
    items:
      - description: Audio clock input used at the SPDIF/AES3 interface.
      - description: Axi4-Lite clock.
      - description: Axi4-Stream global clock signal.

  xlnx,spdif-mode:
    $ref: /schemas/types.yaml#/definitions/uint32
    enum:
      - 0
      - 1
    description: |
      0 - receiver
      1 - transmitter

  xlnx,snd-pcm:
    description: Reference to audio formatter block.
    $ref: /schemas/types.yaml#/definitions/phandle

required:
  - compatible
  - reg
  - interrupts
  - clock-names
  - clocks
  - xlnx,spdif-mode
  - xlnx,snd-pcm

additionalProperties: false

allOf:
  - $ref: dai-common.yaml#
  - if:
      properties:
        xlnx,spdif-mode:
          const: 1 # Transmitter Mode
    then:
      properties:
        clock-names:
          items:
            - const: aud_clk_i
            - const: s_axi_aclk
            - const: s_axis_aclk
    else:
      properties:
        clock-names:
          items:
            - const: aud_clk_i
            - const: s_axi_aclk
            - const: m_axis_aclk

examples:
  - |
    spdif@80010000 {
      compatible = "xlnx,spdif-2.0";
      reg = <0x80010000 0x10000>;
      clock-names = "aud_clk_i", "s_axi_aclk", "s_axis_aclk";
      clocks = <&misc_clk_0>, <&zynqmp_clk 71>, <&misc_clk_0>;
      interrupts = <0 91 4>;
      xlnx,spdif-mode = <1>;
      xlnx,snd-pcm = <&audio_formatter>;
    };
    spdif@80090000 {
      compatible = "xlnx,spdif-2.0";
      reg = <0x80090000 0x10000>;
      clocks = <&misc_clk_0>, <&zynqmp_clk 71>, <&zynqmp_clk 71>;
      clock-names = "aud_clk_i" , "s_axi_aclk" , "m_axis_aclk";
      interrupts = <0 90 4>;
      xlnx,spdif-mode = <0>;
      xlnx,snd-pcm = <&audio_formatter>;
    };
...
```
