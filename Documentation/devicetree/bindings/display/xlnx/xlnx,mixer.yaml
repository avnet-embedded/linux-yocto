## Documentation/devicetree/bindings/display/xlnx/xlnx,mixer.yaml
```yaml
# SPDX-License-Identifier: (GPL-2.0-only OR BSD-2-Clause)
# %YAML 1.2
---
$id: http://devicetree.org/schemas/display/xlnx/xlnx,mixer.yaml#
$schema: http://devicetree.org/meta-schemas/core.yaml#

title: Xilinx Mixer IP.

maintainers:
  - Rajesh Gugulothu <rajesh.gugulothu@amd.com>

description:
  The Xilinx Mixer IP is used to mix multiple input streams
  either as streaming or memory mapped input on single display.

properties:
  compatible:
    oneOf:
      - const: xlnx,v-mix-5.3
      - const: xlnx,mixer-5.0
      - const: xlnx,mixer-4.0
        deprecated: true
      - const: xlnx,mixer-3.0
        deprecated: true

  reg:
    maxItems: 1

  interrupts:
    maxItems: 1

  reset-gpios:
    description: Should contain GPIO reset phandle.
    maxItems: 1

  xlnx,bpc:
    description: Bits per component.
    $ref: /schemas/types.yaml#/definitions/uint32
    enum: [8, 10, 12, 16]

  xlnx,bridge:
    description: The phandle of xilinx video timing controller.
    $ref: /schemas/types.yaml#/definitions/phandle

  xlnx,dma-addr-width:
    description: Size of dma address pointer in IP.
    $ref: /schemas/types.yaml#/definitions/uint32
    enum: [32, 64]

  xlnx,enable-csc-coefficient-register:
    description: Denotes colorimetry coefficients can be programmed.
    type: boolean

  xlnx,logo-layer:
    description: Denotes logo layer is enabled.
    type: boolean

  xlnx,num-layers:
    description: Number of overlay layers enabled.
    $ref: /schemas/types.yaml#/definitions/uint32
    minimum: 1
    maximum: 17

  xlnx,ppc:
    description: Pixels per clock.
    $ref: /schemas/types.yaml#/definitions/uint32
    enum: [1, 2, 4, 8]

  xlnx,video-format:
    description: Mixer output video format (0=RGB,1=YUV444,2=YUV422,3=YUV420).
    $ref: /schemas/types.yaml#/definitions/uint32
    minimum: 0
    maximum: 3

  memory-region:
    description:
      Phandle to the reserved memory nodes to be associated with the
      remoteproc device.
    maxItems: 1

  port:
    $ref: /schemas/graph.yaml#/properties/port
    description: |
      Video output port, typically connected to a panel or bridge.

  logo:
    description: Logo layer as an overlay.
    type: object

    properties:
      xlnx,layer-id:
        description: Number of overlay layers enabled.
        $ref: /schemas/types.yaml#/definitions/uint32
        minimum: 0
        maximum: 16

      xlnx,logo-height:
        description: Maximum number pixels in a line.
        $ref: /schemas/types.yaml#/definitions/uint32
        minimum: 32
        maximum: 64

      xlnx,logo-width:
        description: Maximum number pixels in a line.
        $ref: /schemas/types.yaml#/definitions/uint32
        minimum: 32
        maximum: 64

    required:
      - xlnx,layer-id
      - xlnx,logo-height
      - xlnx,logo-width

    additionalProperties: false

  layer_0:
    description: |
      Primary layer node; requires the following properties:
      - xlnx,layer-max-height
      - xlnx,layer-max-width
      - xlnx,layer-primary
    type: object
    required:
      - xlnx,layer-max-height
      - xlnx,layer-max-width
      - xlnx,layer-primary
    additionalProperties: true

patternProperties:
  "^layer_([0-9]|1[0-6])$":
    type: object
    properties:
      dmas:
        maxItems: 1

      dma-names:
        items:
          - const: dma0

      xlnx,layer-alpha:
        description: Optional; enables alpha compositing for this layer.
        type: boolean

      xlnx,layer-id:
        description: Number of overlay layers enabled.
        $ref: /schemas/types.yaml#/definitions/uint32
        minimum: 0
        maximum: 16

      xlnx,layer-max-height:
        description: Maximum number pixels in a line.
        $ref: /schemas/types.yaml#/definitions/uint32
        minimum: 64
        maximum: 4320

      xlnx,layer-max-width:
        description: Maximum number pixels in a line.
        $ref: /schemas/types.yaml#/definitions/uint32
        minimum: 64
        maximum: 8192

      xlnx,layer-primary:
        description: |
          Indicates this layer is the primary plane (only one layer,
          typically layer_0, should define this).
        type: boolean

      xlnx,layer-scale:
        description: Optional; enables 2x or 4x scaling for this layer.
        type: boolean

      xlnx,layer-streaming:
        description: If input for overlay is streaming or memory mapped.
        type: boolean

      xlnx,vformat:
        description: |
          Mixer IP Format    Driver supported Format String
          BGR888                "RG24"
          RGB888                "BG24"
          XBGR2101010           "XB30"
          XRGB8888              "XR24"
          RGBA8888              "RA24"
          ABGR8888              "AB24"
          ARGB8888              "AR24"
          XBGR8888              "XB24"
          YUYV                  "YUYV"
          UYVY                  "UYVY"
          AYUV                  "AYUV"
          NV12                  "NV12"
          Y8                    "GREY"
          Y10                   "Y10 " (Note: Space included)
          XVUY2101010           "XV30"
          VUY888                "VU24"
          XVUY8888              "XV24"
          XV15                  "XV15"
          XV20                  "XV20"
        $ref: /schemas/types.yaml#/definitions/string
        uniqueItems: true

    required:
      - xlnx,layer-id
      - xlnx,vformat
    additionalProperties: false

required:
  - compatible
  - reg
  - interrupts
  - reset-gpios
  - xlnx,dma-addr-width
  - xlnx,bpc
  - xlnx,ppc
  - xlnx,num-layers
  - xlnx,video-format

additionalProperties: false

allOf:
  - if:
      properties:
        compatible:
          contains:
            const: xlnx,mixer-3.0
    then:
      properties:
        xlnx,num-layers:
          maximum: 9
  - if:
      properties:
        compatible:
          contains:
            enum:
              - xlnx,mixer-4.0
              - xlnx,mixer-5.0
              - xlnx,v-mix-5.3
    then:
      properties:
        xlnx,num-layers:
          maximum: 17
  - if:
      properties:
        compatible:
          contains:
            enum:
              - xlnx,mixer-5.0
              - xlnx,v-mix-5.3
    then:
      required:
        - xlnx,enable-csc-coefficient-register

examples:
  - |
    #include <dt-bindings/interrupt-controller/arm-gic.h>

    v_mix@a0070000 {
        compatible = "xlnx,v-mix-5.3";
        reg = <0xa0070000 0x10000>;
        interrupts = <GIC_SPI 95 IRQ_TYPE_LEVEL_HIGH>;
        reset-gpios = <&gpio 98 1>;
        xlnx,bpc = <8>;
        xlnx,dma-addr-width = <64>;
        xlnx,num-layers = <9>;
        xlnx,ppc = <2>;
        xlnx,logo-layer;
        xlnx,video-format = <0>;
        xlnx,bridge = <&v_tc_0>;
        xlnx,enable-csc-coefficient-register;
        port {
            #address-cells = <1>;
            #size-cells = <0>;
            mix_out1: endpoint@0 {
                reg = <0>;
                remote-endpoint = <&hdmi_output_v_mix_0>;
            };
        };
        overlay0: layer_0 {
          dma-names = "dma0";
          dmas = <&hdmi_output_v_frmbuf_rd_0 0>;
          xlnx,layer-id = <0>;
          xlnx,layer-max-height = <2160>;
          xlnx,layer-max-width = <3840>;
          xlnx,layer-primary;
          xlnx,vformat = "YUYV";
          xlnx,layer-streaming;
        };
        overlay1: layer_1 {
          xlnx,layer-id = <1>;
          xlnx,vformat = "YUYV";
          xlnx,layer-alpha;
          xlnx,layer-scale;
          xlnx,layer-max-width = <1920>;
        };
        overlay2: layer_2 {
          xlnx,layer-id = <2>;
          xlnx,vformat = "YUYV";
          xlnx,layer-alpha;
          xlnx,layer-scale;
          xlnx,layer-max-width = <1920>;
        };
        overlay3: layer_3 {
          xlnx,layer-id = <3>;
          xlnx,vformat = "YUYV";
          xlnx,layer-alpha;
          xlnx,layer-scale;
          xlnx,layer-max-width = <1920>;
        };
        overlay4: layer_4 {
          xlnx,layer-id = <4>;
          xlnx,vformat = "YUYV";
          xlnx,layer-alpha;
          xlnx,layer-scale;
          xlnx,layer-max-width = <1920>;
        };
        overlay5: layer_5 {
          xlnx,layer-id = <5>;
          xlnx,vformat = "YUYV";
          xlnx,layer-alpha;
          xlnx,layer-scale;
          xlnx,layer-max-width = <1920>;
        };
        overlay6: layer_6 {
          xlnx,layer-id = <6>;
          xlnx,vformat = "YUYV";
          xlnx,layer-alpha;
          xlnx,layer-scale;
          xlnx,layer-max-width = <1920>;
        };
        overlay7: layer_7 {
          xlnx,layer-id = <7>;
          xlnx,vformat = "YUYV";
          xlnx,layer-alpha;
          xlnx,layer-scale;
          xlnx,layer-max-width = <1920>;
        };
        logo_layer: logo {
            xlnx,layer-id = <8>;
            xlnx,logo-height = <64>;
            xlnx,logo-width = <64>;
        };
    };

  - |
    #include <dt-bindings/interrupt-controller/arm-gic.h>

    reserved-memory {
        #address-cells = <1>;
        #size-cells = <1>;
        ranges;
        psmem_multimedia: multimedia_cma_mem_region@40000000 {
            compatible = "shared-dma-pool";
            reg = <0x0 0x40000000 0x0 0x20000000>;
            reusable;
        };
    };

    v_mix@80200000 {
        compatible = "xlnx,v-mix-5.3";
        reg = <0x80200000 0x10000>;
        interrupts = <GIC_SPI 95 IRQ_TYPE_LEVEL_HIGH>;
        reset-gpios = <&gpio 98 1>;
        xlnx,bpc = <8>;
        xlnx,dma-addr-width = <64>;
        xlnx,num-layers = <4>;
        xlnx,ppc = <2>;
        xlnx,logo-layer;
        xlnx,video-format = <0>;
        xlnx,bridge = <&v_tc_0>;
        memory-region = <&psmem_multimedia>;
        xlnx,enable-csc-coefficient-register;
        port {
            #address-cells = <1>;
            #size-cells = <0>;
            mix_out2: endpoint@0 {
                reg = <0>;
                remote-endpoint = <&hdmi_output_v_mix_2>;
            };
        };
        layer_0 {
          dma-names = "dma0";
          dmas = <&hdmi_output_v_frmbuf_rd_0 0>;
          xlnx,layer-id = <0>;
          xlnx,layer-max-height = <2160>;
          xlnx,layer-max-width = <3840>;
          xlnx,layer-primary;
          xlnx,vformat = "YUYV";
          xlnx,layer-streaming;
        };
        layer_1 {
          xlnx,layer-id = <1>;
          xlnx,vformat = "YUYV";
          xlnx,layer-alpha;
          xlnx,layer-scale;
          xlnx,layer-max-width = <1920>;
        };
        layer_2 {
          xlnx,layer-id = <2>;
          xlnx,vformat = "YUYV";
          xlnx,layer-alpha;
          xlnx,layer-scale;
          xlnx,layer-max-width = <1920>;
        };
        logo {
            xlnx,layer-id = <3>;
            xlnx,logo-height = <64>;
            xlnx,logo-width = <64>;
        };
    };

  - |
    #include <dt-bindings/interrupt-controller/arm-gic.h>

    reserved-memory {
        #address-cells = <1>;
        #size-cells = <1>;
        ranges;
        plmem_multimedia: multimedia_dma_mem_region@4800000000 {
            compatible = "shared-dma-pool";
            no-map;
            reg = <0x48 0x0 0x0 0x70000000>;
        };
    };

    v_mix@80100000 {
        compatible = "xlnx,v-mix-5.3";
        reg = <0x80100000 0x10000>;
        interrupts = <GIC_SPI 95 IRQ_TYPE_LEVEL_HIGH>;
        reset-gpios = <&gpio 98 1>;
        xlnx,bpc = <8>;
        xlnx,dma-addr-width = <64>;
        xlnx,num-layers = <4>;
        xlnx,ppc = <2>;
        xlnx,logo-layer;
        xlnx,video-format = <0>;
        xlnx,bridge = <&v_tc_0>;
        memory-region = <&plmem_multimedia>;
        xlnx,enable-csc-coefficient-register;
        port {
            #address-cells = <1>;
            #size-cells = <0>;
            mix_out: endpoint@0 {
                reg = <0>;
                remote-endpoint = <&hdmi_output_v_mix_0>;
            };
        };
        layer_0 {
          dma-names = "dma0";
          dmas = <&hdmi_output_v_frmbuf_rd_0 0>;
          xlnx,layer-id = <0>;
          xlnx,layer-max-height = <2160>;
          xlnx,layer-max-width = <3840>;
          xlnx,layer-primary;
          xlnx,vformat = "YUYV";
          xlnx,layer-streaming;
        };
        layer_1 {
          xlnx,layer-id = <1>;
          xlnx,vformat = "YUYV";
          xlnx,layer-alpha;
          xlnx,layer-scale;
          xlnx,layer-max-width = <1920>;
        };
        layer_2 {
          xlnx,layer-id = <2>;
          xlnx,vformat = "YUYV";
          xlnx,layer-alpha;
          xlnx,layer-scale;
          xlnx,layer-max-width = <1920>;
        };
        logo {
            xlnx,layer-id = <3>;
            xlnx,logo-height = <64>;
            xlnx,logo-width = <64>;
        };
    };
```

## Documentation/devicetree/bindings/sound/xlnx,audio-formatter.yaml
```yaml
# SPDX-License-Identifier: (GPL-2.0-only OR BSD-2-Clause)
%YAML 1.2
---
$id: http://devicetree.org/schemas/sound/xlnx,audio-formatter.yaml#
$schema: http://devicetree.org/meta-schemas/core.yaml#

title: Xilinx PL audio formatter

description:
  The IP core supports DMA, data formatting(AES<->PCM conversion)
  of audio samples.

maintainers:
  - Vincenzo Frascino <vincenzo.frascino@arm.com>

allOf:
  - $ref: dai-common.yaml#

properties:
  compatible:
    enum:
      - xlnx,audio-formatter-1.0

  reg:
    maxItems: 1

  interrupt-names:
    minItems: 1
    items:
      - const: irq_mm2s
      - const: irq_s2mm

  interrupts:
    minItems: 1
    items:
      - description: interrupt from MM2S block
      - description: interrupt from S2MM block

  clock-names:
    minItems: 1
    items:
      - const: s_axi_lite_aclk
      - const: aud_mclk
      - const: m_axis_mm2s_aclk
      - const: s_axis_s2mm_aclk

  clocks:
    minItems: 1
    items:
      - description: clock for the axi data stream
      - description: clock for the MEMS microphone data stream
      - description: master AXI interface
      - description: slave AXI interface

  xlnx,tx:
    description: |
      Connected audio sink node.
           Should be one of below supported nodes:
               1. HDMI video Tx output
               2. I2S transmitter
               3. UHDSDI audio embed
           Only those nodes were supported in sound card driver
    $ref: /schemas/types.yaml#/definitions/phandle

  xlnx,rx:
    description: |
      Connected audio source node.
           Should be one of below supported nodes:
               1. HDMI video Rx input
               2. I2S receiver
               3. UHDSDI audio extract
           Only those nodes were supported in sound card driver
    $ref: /schemas/types.yaml#/definitions/phandle

required:
  - compatible
  - reg
  - interrupt-names
  - interrupts
  - clock-names
  - clocks
  - xlnx,tx
  - xlnx,rx

additionalProperties: false

examples:
  - |
    audio_formatter@80010000 {
      compatible = "xlnx,audio-formatter-1.0";
      reg = <0x80010000 0x1000>;
      interrupt-names = "irq_mm2s", "irq_s2mm";
      interrupt-parent = <&gic>;
      interrupts = <0 104 4>, <0 105 4>;
      xlnx,tx = <&i2s_transmitter>;
      xlnx,rx = <&i2s_receiver>;
      clock-names = "s_axi_lite_aclk", "aud_mclk", "m_axis_mm2s_aclk", "s_axis_s2mm_aclk";
      clocks = <&clk 71>, <&audio_ss_0_clk_wiz_0 0>, <&audio_ss_0_clk_wiz_0 0>, <&clk 71>;
    };
...
```
