// SPDX-License-Identifier: GPL-2.0-or-later OR MIT
/*
 * Device Tree file for S32G-VNP-PROC + S32GRV-VNP-PLAT boards
 *
 * Copyright 2021-2023 NXP
 */

/dts-v1/;

#include "s32g2.dtsi"
#include "s32g2xxa-evb.dtsi"
