## drivers/mxc/Kconfig
```kconfig
source "drivers/mxc/mipi/Kconfig"

# drivers/mxc/Kconfig

if ARCH_MXC

menu "MXC support drivers"

source "drivers/mxc/gpu-viv/Kconfig"
source "drivers/mxc/mlb/Kconfig"

config MXC_SIM
	tristate "MXC SIM support"
	default n
	help
	Say Y to get MXC SIM support.

source "drivers/mxc/sim/Kconfig"

#if ARCH_MXC_ARM64
source "drivers/mxc/hantro/Kconfig"
source "drivers/mxc/hantro_845/Kconfig"
source "drivers/mxc/hantro_845_h1/Kconfig"
source "drivers/mxc/hantro_vc8000e/Kconfig"
source "drivers/mxc/hantro_v4l2/Kconfig"
#endif

source "drivers/mxc/vpu/Kconfig"

endmenu

endif
```
